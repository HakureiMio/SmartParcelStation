## clip-node-nrf52810/boards/nordic/clip_node_nrf52810/Kconfig.clip_node_nrf52810
```kconfig
# SPDX-License-Identifier: Apache-2.0

config BOARD_CLIP_NODE_NRF52810
	select SOC_NRF52810_QFAA
```

## clip-node-nrf52810/boards/nordic/clip_node_nrf52810/Kconfig.defconfig
```kconfig
# SPDX-License-Identifier: Apache-2.0

if BOARD_CLIP_NODE_NRF52810

config GPIO
	default y

config PWM
	default y

config ADC
	default y

config SERIAL
	default n

config CONSOLE
	default n

config UART_CONSOLE
	default n

config USE_SEGGER_RTT
	default y

config LOG_BACKEND_RTT
	default y

endif # BOARD_CLIP_NODE_NRF52810
```

## clip-node-nrf52810/boards/nordic/clip_node_nrf52810/board.yml
```yaml
board:
  name: clip_node_nrf52810
  full_name: Smart Parcel Clip Node nRF52810
  vendor: smartparcel
  socs:
  - name: nrf52810
```

## clip-node-nrf52810/boards/nordic/clip_node_nrf52810/clip_node_nrf52810_defconfig
```kconfig
# SPDX-License-Identifier: Apache-2.0

CONFIG_ARM_MPU=y
CONFIG_GPIO=y
CONFIG_PWM=y
CONFIG_ADC=y
CONFIG_SERIAL=n
CONFIG_CONSOLE=n
CONFIG_UART_CONSOLE=n
CONFIG_USE_SEGGER_RTT=n
CONFIG_LOG_BACKEND_RTT=n
```

## clip-node-nrf52810/build-codex-verify/Kconfig/Kconfig.shield.defconfig
```kconfig
osource "D:/Project/SmartParcelStation/clip-node-nrf52810/boards/shields/*/Kconfig.defconfig"
osource "D:/Tools/ProgramData/ncs/v3.2.4/nrf/boards/shields/*/Kconfig.defconfig"
```

## clip-node-nrf52810/build-codex-verify/clip-node-nrf52810/Kconfig/Kconfig.shield
```kconfig
osource "D:/Project/SmartParcelStation/clip-node-nrf52810/boards/shields/*/Kconfig.shield"
osource "D:/Tools/ProgramData/ncs/v3.2.4/nrf/boards/shields/*/Kconfig.shield"
```

## clip-node-nrf52810/build-codex-verify/clip-node-nrf52810/Kconfig/boards/Kconfig
```kconfig
# Load Zephyr board Kconfig descriptions.
osource "D:/Project/SmartParcelStation/clip-node-nrf52810/boards/nordic/clip_node_nrf52810/Kconfig"
```

## clip-node-nrf52810/build/Kconfig/arch/Kconfig
```kconfig
# Load Zephyr Arch Kconfig descriptions.
osource "D:/Tools/ProgramData/ncs/v3.2.4/zephyr/arch/rx/Kconfig"
osource "D:/Tools/ProgramData/ncs/v3.2.4/zephyr/arch/x86/Kconfig"
osource "D:/Tools/ProgramData/ncs/v3.2.4/zephyr/arch/xtensa/Kconfig"
osource "D:/Tools/ProgramData/ncs/v3.2.4/zephyr/arch/sparc/Kconfig"
osource "D:/Tools/ProgramData/ncs/v3.2.4/zephyr/arch/riscv/Kconfig"
osource "D:/Tools/ProgramData/ncs/v3.2.4/zephyr/arch/posix/Kconfig"
osource "D:/Tools/ProgramData/ncs/v3.2.4/zephyr/arch/mips/Kconfig"
osource "D:/Tools/ProgramData/ncs/v3.2.4/zephyr/arch/arm64/Kconfig"
osource "D:/Tools/ProgramData/ncs/v3.2.4/zephyr/arch/arm/Kconfig"
osource "D:/Tools/ProgramData/ncs/v3.2.4/zephyr/arch/arc/Kconfig"
```

## clip-node-nrf52810/build/Kconfig/boards/Kconfig.defconfig
```kconfig
# Load Zephyr board defconfig descriptions.
osource "D:/Project/SmartParcelStation/clip-node-nrf52810/boards/nordic/clip_node_nrf52810/Kconfig.defconfig"
```

## clip-node-nrf52810/build/clip-node-nrf52810/Kconfig/soc/Kconfig
```kconfig
# Load Zephyr SoC Kconfig descriptions.
osource "D:/Tools/ProgramData/ncs/v3.2.4/zephyr/soc/xlnx/zynqmp/Kconfig"
osource "D:/Tools/ProgramData/ncs/v3.2.4/zephyr/soc/xlnx/zynq7000/Kconfig"
osource "D:/Tools/ProgramData/ncs/v3.2.4/zephyr/soc/xlnx/versalnet/Kconfig"
osource "D:/Tools/ProgramData/ncs/v3.2.4/zephyr/soc/xlnx/versal2/Kconfig"
osource "D:/Tools/ProgramData/ncs/v3.2.4/zephyr/soc/xen/Kconfig"
osource "D:/Tools/ProgramData/ncs/v3.2.4/zephyr/soc/wch/ch32v/Kconfig"
osource "D:/Tools/ProgramData/ncs/v3.2.4/zephyr/soc/ti/simplelink/Kconfig"
osource "D:/Tools/ProgramData/ncs/v3.2.4/zephyr/soc/ti/mspm0/Kconfig"
osource "D:/Tools/ProgramData/ncs/v3.2.4/zephyr/soc/ti/lm3s6965/Kconfig"
osource "D:/Tools/ProgramData/ncs/v3.2.4/zephyr/soc/ti/k3/Kconfig"
osource "D:/Tools/ProgramData/ncs/v3.2.4/zephyr/soc/telink/tlsr/Kconfig"
osource "D:/Tools/ProgramData/ncs/v3.2.4/zephyr/soc/starfive/jh71xx/Kconfig"
osource "D:/Tools/ProgramData/ncs/v3.2.4/zephyr/soc/st/stm32/Kconfig"
osource "D:/Tools/ProgramData/ncs/v3.2.4/zephyr/soc/snps/qemu_arc/Kconfig"
osource "D:/Tools/ProgramData/ncs/v3.2.4/zephyr/soc/snps/nsim/arc_v/Kconfig"
osource "D:/Tools/ProgramData/ncs/v3.2.4/zephyr/soc/snps/nsim/arc_classic/Kconfig"
osource "D:/Tools/ProgramData/ncs/v3.2.4/zephyr/soc/snps/hsdk4xd/Kconfig"
osource "D:/Tools/ProgramData/ncs/v3.2.4/zephyr/soc/snps/hsdk/Kconfig"
osource "D:/Tools/ProgramData/ncs/v3.2.4/zephyr/soc/snps/emsk/Kconfig"
osource "D:/Tools/ProgramData/ncs/v3.2.4/zephyr/soc/snps/emsdp/Kconfig"
osource "D:/Tools/ProgramData/ncs/v3.2.4/zephyr/soc/snps/arc_iot/Kconfig"
osource "D:/Tools/ProgramData/ncs/v3.2.4/zephyr/soc/silabs/Kconfig"
osource "D:/Tools/ProgramData/ncs/v3.2.4/zephyr/soc/sifive/sifive_freedom/Kconfig"
osource "D:/Tools/ProgramData/ncs/v3.2.4/zephyr/soc/sensry/Kconfig"
osource "D:/Tools/ProgramData/ncs/v3.2.4/zephyr/soc/rockchip/Kconfig"
osource "D:/Tools/ProgramData/ncs/v3.2.4/zephyr/soc/renode/riscv_virtual/Kconfig"
osource "D:/Tools/ProgramData/ncs/v3.2.4/zephyr/soc/renode/cortex_r8_virtual/Kconfig"
osource "D:/Tools/ProgramData/ncs/v3.2.4/zephyr/soc/renesas/smartbond/Kconfig"
osource "D:/Tools/ProgramData/ncs/v3.2.4/zephyr/soc/renesas/rz/Kconfig"
osource "D:/Tools/ProgramData/ncs/v3.2.4/zephyr/soc/renesas/rx/Kconfig"
osource "D:/Tools/ProgramData/ncs/v3.2.4/zephyr/soc/renesas/rcar/Kconfig"
osource "D:/Tools/ProgramData/ncs/v3.2.4/zephyr/soc/renesas/ra/Kconfig"
osource "D:/Tools/ProgramData/ncs/v3.2.4/zephyr/soc/realtek/ec/Kconfig"
osource "D:/Tools/ProgramData/ncs/v3.2.4/zephyr/soc/raspberrypi/rpi_pico/Kconfig"
osource "D:/Tools/ProgramData/ncs/v3.2.4/zephyr/soc/quicklogic/eos_s3/Kconfig"
osource "D:/Tools/ProgramData/ncs/v3.2.4/zephyr/soc/qemu/virt_riscv/Kconfig"
osource "D:/Tools/ProgramData/ncs/v3.2.4/zephyr/soc/qemu/malta/Kconfig"
osource "D:/Tools/ProgramData/ncs/v3.2.4/zephyr/soc/openisa/rv32m1/Kconfig"
osource "D:/Tools/ProgramData/ncs/v3.2.4/zephyr/soc/openhwgroup/cva6/Kconfig"
osource "D:/Tools/ProgramData/ncs/v3.2.4/zephyr/soc/oct/osd32mp15x/Kconfig"
osource "D:/Tools/ProgramData/ncs/v3.2.4/zephyr/soc/nxp/s32/Kconfig"
osource "D:/Tools/ProgramData/ncs/v3.2.4/zephyr/soc/nxp/rw/Kconfig"
osource "D:/Tools/ProgramData/ncs/v3.2.4/zephyr/soc/nxp/mcx/Kconfig"
osource "D:/Tools/ProgramData/ncs/v3.2.4/zephyr/soc/nxp/lpc/Kconfig"
osource "D:/Tools/ProgramData/ncs/v3.2.4/zephyr/soc/nxp/layerscape/Kconfig"
osource "D:/Tools/ProgramData/ncs/v3.2.4/zephyr/soc/nxp/kinetis/Kconfig"
osource "D:/Tools/ProgramData/ncs/v3.2.4/zephyr/soc/nxp/imxrt/Kconfig"
osource "D:/Tools/ProgramData/ncs/v3.2.4/zephyr/soc/nxp/imx/Kconfig"
osource "D:/Tools/ProgramData/ncs/v3.2.4/zephyr/soc/nuvoton/numicro/Kconfig"
osource "D:/Tools/ProgramData/ncs/v3.2.4/zephyr/soc/nuvoton/numaker/Kconfig"
osource "D:/Tools/ProgramData/ncs/v3.2.4/zephyr/soc/nuvoton/npcx/Kconfig"
osource "D:/Tools/ProgramData/ncs/v3.2.4/zephyr/soc/nuvoton/npcm/Kconfig"
osource "D:/Tools/ProgramData/ncs/v3.2.4/zephyr/soc/nordic/Kconfig"
osource "D:/Tools/ProgramData/ncs/v3.2.4/zephyr/soc/neorv32/Kconfig"
osource "D:/Tools/ProgramData/ncs/v3.2.4/zephyr/soc/native/inf_clock/Kconfig"
osource "D:/Tools/ProgramData/ncs/v3.2.4/zephyr/soc/microchip/sam/Kconfig"
osource "D:/Tools/ProgramData/ncs/v3.2.4/zephyr/soc/microchip/sam/sam_d5x_e5x/Kconfig"
osource "D:/Tools/ProgramData/ncs/v3.2.4/zephyr/soc/microchip/miv/Kconfig"
osource "D:/Tools/ProgramData/ncs/v3.2.4/zephyr/soc/microchip/mec/Kconfig"
osource "D:/Tools/ProgramData/ncs/v3.2.4/zephyr/soc/mediatek/mt8xxx/Kconfig"
osource "D:/Tools/ProgramData/ncs/v3.2.4/zephyr/soc/lowrisc/opentitan/Kconfig"
osource "D:/Tools/ProgramData/ncs/v3.2.4/zephyr/soc/litex/litex_vexriscv/Kconfig"
osource "D:/Tools/ProgramData/ncs/v3.2.4/zephyr/soc/ite/ec/Kconfig"
osource "D:/Tools/ProgramData/ncs/v3.2.4/zephyr/soc/intel/raptor_lake/Kconfig"
osource "D:/Tools/ProgramData/ncs/v3.2.4/zephyr/soc/intel/panther_lake/Kconfig"
osource "D:/Tools/ProgramData/ncs/v3.2.4/zephyr/soc/intel/lakemont/Kconfig"
osource "D:/Tools/ProgramData/ncs/v3.2.4/zephyr/soc/intel/intel_socfpga_std/Kconfig"
osource "D:/Tools/ProgramData/ncs/v3.2.4/zephyr/soc/intel/intel_socfpga/Kconfig"
osource "D:/Tools/ProgramData/ncs/v3.2.4/zephyr/soc/intel/intel_niosv/Kconfig"
osource "D:/Tools/ProgramData/ncs/v3.2.4/zephyr/soc/intel/intel_ish/Kconfig"
osource "D:/Tools/ProgramData/ncs/v3.2.4/zephyr/soc/intel/intel_adsp/Kconfig"
osource "D:/Tools/ProgramData/ncs/v3.2.4/zephyr/soc/intel/elkhart_lake/Kconfig"
osource "D:/Tools/ProgramData/ncs/v3.2.4/zephyr/soc/intel/atom/Kconfig"
osource "D:/Tools/ProgramData/ncs/v3.2.4/zephyr/soc/intel/apollo_lake/Kconfig"
osource "D:/Tools/ProgramData/ncs/v3.2.4/zephyr/soc/intel/alder_lake/Kconfig"
osource "D:/Tools/ProgramData/ncs/v3.2.4/zephyr/soc/infineon/cat3/Kconfig"
osource "D:/Tools/ProgramData/ncs/v3.2.4/zephyr/soc/infineon/cat1c/Kconfig"
osource "D:/Tools/ProgramData/ncs/v3.2.4/zephyr/soc/infineon/cat1b/Kconfig"
osource "D:/Tools/ProgramData/ncs/v3.2.4/zephyr/soc/infineon/cat1a/Kconfig"
osource "D:/Tools/ProgramData/ncs/v3.2.4/zephyr/soc/gd/gd32/Kconfig"
osource "D:/Tools/ProgramData/ncs/v3.2.4/zephyr/soc/gaisler/leon3/Kconfig"
osource "D:/Tools/ProgramData/ncs/v3.2.4/zephyr/soc/gaisler/gr716a/Kconfig"
osource "D:/Tools/ProgramData/ncs/v3.2.4/zephyr/soc/espressif/Kconfig"
osource "D:/Tools/ProgramData/ncs/v3.2.4/zephyr/soc/ene/kb1200/Kconfig"
osource "D:/Tools/ProgramData/ncs/v3.2.4/zephyr/soc/ene/kb106x/Kconfig"
osource "D:/Tools/ProgramData/ncs/v3.2.4/zephyr/soc/efinix/sapphire/Kconfig"
osource "D:/Tools/ProgramData/ncs/v3.2.4/zephyr/soc/cdns/xtensa_sample_controller/Kconfig"
osource "D:/Tools/ProgramData/ncs/v3.2.4/zephyr/soc/cdns/sample_controller32/Kconfig"
osource "D:/Tools/ProgramData/ncs/v3.2.4/zephyr/soc/cdns/dc233c/Kconfig"
osource "D:/Tools/ProgramData/ncs/v3.2.4/zephyr/soc/brcm/bcmvk/Kconfig"
osource "D:/Tools/ProgramData/ncs/v3.2.4/zephyr/soc/brcm/bcm2712/Kconfig"
osource "D:/Tools/ProgramData/ncs/v3.2.4/zephyr/soc/brcm/bcm2711/Kconfig"
osource "D:/Tools/ProgramData/ncs/v3.2.4/zephyr/soc/bflb/Kconfig"
osource "D:/Tools/ProgramData/ncs/v3.2.4/zephyr/soc/atmel/sam0/Kconfig"
osource "D:/Tools/ProgramData/ncs/v3.2.4/zephyr/soc/atmel/sam/Kconfig"
osource "D:/Tools/ProgramData/ncs/v3.2.4/zephyr/soc/aspeed/Kconfig"
osource "D:/Tools/ProgramData/ncs/v3.2.4/zephyr/soc/arm/Kconfig"
osource "D:/Tools/ProgramData/ncs/v3.2.4/zephyr/soc/arm/beetle/Kconfig"
osource "D:/Tools/ProgramData/ncs/v3.2.4/zephyr/soc/antmicro/myra/Kconfig"
osource "D:/Tools/ProgramData/ncs/v3.2.4/zephyr/soc/andestech/Kconfig"
osource "D:/Tools/ProgramData/ncs/v3.2.4/zephyr/soc/amd/acp_6_0/Kconfig"
osource "D:/Tools/ProgramData/ncs/v3.2.4/zephyr/soc/ambiq/Kconfig"
osource "D:/Tools/ProgramData/ncs/v3.2.4/zephyr/soc/aesc/Kconfig"
osource "D:/Tools/ProgramData/ncs/v3.2.4/zephyr/soc/adi/max32/Kconfig"
osource "D:/Tools/ProgramData/ncs/v3.2.4/nrf/soc/sercomm/nrf91/Kconfig"
osource "D:/Tools/ProgramData/ncs/v3.2.4/nrf/soc/nordic/Kconfig"
```

## gate-access-esp32s3/sdkconfig.defaults
```kconfig
CONFIG_IDF_TARGET="esp32s3"
CONFIG_ESP_MAIN_TASK_STACK_SIZE=8192
CONFIG_ESP_SYSTEM_EVENT_TASK_STACK_SIZE=4096
CONFIG_ESP_HTTP_CLIENT_ENABLE_HTTPS=n
CONFIG_LOG_DEFAULT_LEVEL_INFO=y
CONFIG_LOG_MAXIMUM_LEVEL_INFO=y
```

## gate-access/sdkconfig.defaults
```kconfig
CONFIG_IDF_TARGET="esp32p4"
CONFIG_ESPTOOLPY_FLASHSIZE_8MB=y
CONFIG_ESP32P4_SELECTS_REV_LESS_V3=y
CONFIG_ESP32P4_REV_MIN_100=y
CONFIG_ESP_DEFAULT_CPU_FREQ_MHZ_360=y
CONFIG_SPIRAM=y
CONFIG_SPIRAM_MODE_HEX=y
CONFIG_SPIRAM_SPEED_200M=y
```
